// -------------------------------------------------------------------------------
/*
  This is an SD card control program.
  Functionality:
  + List directory.
  + Set SD card for processing.

  MEMSIZE
  MREAD(i);
  MWRITE(i, memoryData);

  host_set_status_led_HLDA();
  host_clr_status_led_HLDA();
  playerPlaySoundWait(WRITE_FILE);

  modeDownloadProgram();
  controlResetLogic();
  getSenseSwitchValue()
  readConfirmByte

  printFrontPanel();
  fpAddressToggleWord
*/
// -------------------------------------------------------------------------------

#include "Altair101b.h"

String sdCardPrompt = "CARD ?- ";
String sdCardSetPrompt = "CARD DL ?- ";
String thePrompt = sdCardPrompt;           // Default.
extern int programState;

// -----------------------------------------------------------------------------
// -----------------------------------------------------------------------------
// SD Card setup and functions.

#define SETUP_SDCARD 1
String theFilename;

#ifdef SETUP_SDCARD

// SD Card module is an SPI bus slave device.
#include <SPI.h>
#include <SD.h>

//     Mega Nano - SPI module pins
// Pin 53   10   - CS   : chip/slave select (SS pin). Can be any master(Nano) digital pin to enable/disable this device on the SPI bus.
// Pin 52   13   - SCK  : serial clock, SPI: accepts clock pulses which synchronize data transmission generated by Arduino.
// Pin 51   11   - MOSI : master out slave in, SPI: input to the Micro SD Card Module.
// Pin 50   12   - MISO : master in slave Out, SPI: output from the Micro SD Card Module.
// Pin 5V+  - VCC  : can use 3.3V or 5V
// Pin GND  - GND  : ground
// Note, Nano pins are declared in the SPI library for SCK, MOSI, and MISO.

// The CS pin is the only one that is not really fixed as any of the Arduino digital pin.
// const int csPin = 10;  // SD Card module is connected to Nano pin 10.
const int csPin = 53;     // SD Card module is connected to Mega pin 53.

File myFile;

// -----------------------------------------------------------------------------
// SD card module functions
// The csPin pin is connected to the SD card module select pin (CS).

// Handle the case if the card is not inserted. Once inserted, the module will be re-initialized.
boolean sdcardInitiated = false;
void setupSdCard() {
  delay(300);
  if (!SD.begin(csPin)) {
    Serial.println(F("- Error initializing SD card module."));
    ledFlashError();
    hwStatus = 1;
    sdcardInitiated = false;
    Serial.println(F("- Error initializing SD card."));
    Serial.println(F("-- Check that SD card is inserted"));
    Serial.println(F("-- Check that SD card adapter is wired properly."));
    // Optionally, retry for a period of time.
  } else {
    Serial.println(F("+ Initialized: SD card module."));
    ledFlashSuccess();
  }
}

// -----------------------------------------------------------------------------
// Write Program memory to a file.

void writeProgramMemoryToFile(String theFilename) {
  if (!sdcardInitiated) {
    setupSdCard();
  }
  if (SD.exists(theFilename)) {
    SD.remove(theFilename);
    Serial.println(F("++ Exists, so it was deleted."));
  }
  myFile = SD.open(theFilename, FILE_WRITE);
  if (!myFile) {
    Serial.print(F("- Error opening file: "));
    Serial.println(theFilename);
    ledFlashError();
    sdcardInitiated = false;
    return; // When used in setup(), causes jump to loop().
  }
  host_set_status_led_HLDA();
  for (int i = 0; i < MEMSIZE; i++) {
    byte memoryData = MREAD(i);
    myFile.write(memoryData);
  }
  myFile.close();
  Serial.println(F("+ Write completed, file closed."));
  ledFlashSuccess();
  playerPlaySoundWait(WRITE_FILE);
  host_clr_status_led_HLDA();
}

// -----------------------------------------------------------------------------
// Read program memory from a file.

boolean readProgramFileIntoMemory(String theFilename) {
  if (!sdcardInitiated) {
    setupSdCard();
  }
  // Serial.println(F("+ Read a file into program memory, file named: "));
  // Serial.print(theFilename);
  // Serial.println(F("+ Check if file exists. "));
  if (!SD.exists(theFilename)) {
    Serial.print(F("- Read ERROR, file doesn't exist: "));
    Serial.println(theFilename);
    ledFlashError();
    sdcardInitiated = false;
    return (false);
  }
  myFile = SD.open(theFilename);
  if (!myFile) {
    Serial.print(F("- Read ERROR, cannot open file: "));
    Serial.println(theFilename);
    ledFlashError();
    sdcardInitiated = false;
    return (false);
  }
  host_set_status_led_HLDA();
  int i = 0;
  while (myFile.available()) {
    // Reads one character at a time.
    byte memoryData = myFile.read();
    MWRITE(i, memoryData);
#ifdef LOG_MESSAGES
    // Print Binary:Octal:Decimal values.
    Serial.print(F("B"));
    printByte(MREAD(i));
    Serial.print(F(":"));
    printOctal(MREAD(i));
    Serial.print(F(":"));
    Serial.println(MREAD(i), DEC);
#endif
    i++;
    if (i > MEMSIZE) {
      Serial.println(F("-+ Warning, file contains more data bytes than available memory."));
      ledFlashError();
      break;
    }
  }
  myFile.close();
  Serial.println(F("+ Program file loaded and ready to use."));
  controlResetLogic();
  playerPlaySoundWait(READ_FILE);
  host_clr_status_led_HLDA();
  return (true);
}

// -----------------------------------------------------------------------------
// Directory listing

void printSpacing(String theString) {
  for (int i = theString.length(); i < 14; i++) {
    Serial.print(F(" "));
  }
}

void sdListDirectory() {
  if (!sdcardInitiated) {
    setupSdCard();
  }
  // listDirectory(root);
  // List files for a single directory.
  File dir = SD.open("/");
  String tabString = "   ";
  File entry = dir.openNextFile();
  while (entry) {
    if (entry.isDirectory()) {
      Serial.print(F("++ Directory: "));
      Serial.print(entry.name());
    } else {
      Serial.print(F("++ File:      "));
      Serial.print(entry.name());
      printSpacing(entry.name());
      Serial.print(entry.size(), DEC);
    }
    Serial.println();
    entry.close();
    entry =  dir.openNextFile();
  }
  dir.close();
}
#endif  // SETUP_SDCARD

// -----------------------------------------------------------------------
// -----------------------------------------------------------------------
// SD Card Controls

void sdCardSwitch(int resultsValue) {
  boolean printPrompt = true;
  switch (resultsValue) {
    // -----------------------------------
    case 0xFFFFFFFF:
      // Ignore. This is from holding the key down.
      return;     // To avoid printing the prompt.
      break;
    // -------------
    // Mouse wheel
    case 27:
    case 91:
    case 65: // Mouse wheel down (away from user).
    case 66: // Mouse wheel up   (toward user).
      // Ignore.
      return;     // To avoid printing the prompt.
      break;
    // -------------
    case 10:
      // LF, IDE character.
      // Ignore.
      return;     // To avoid printing the prompt.
      break;
    // -------------
    case 13:
      // CR, Mac terminal window character. ignore
      Serial.println();
      break;
    // ----------------------------------------------------------------------
    // Controls
    //
    // -----------------------------------
    case 'r':
      Serial.println(F("+ 'r', ..."));
      Serial.println();
      break;
    case 'n':
      Serial.println(F("+ n, SD card directory lising."));
      sdListDirectory();
      break;
    case 'm':
      {
        Serial.println(F("+ m, Read file into program memory."));
        theFilename = getSenseSwitchValue() + ".bin";
        if (theFilename == "00000000.bin") {
          Serial.println(F("+ Set to download over the serial port."));
          programState = SERIAL_DOWNLOAD;
          return;
        }
        Serial.print(F("++ Program filename: "));
        Serial.println(theFilename);
        Serial.println(F("++ Confirm, y/n: "));
        readConfirmByte = 's';
        while (!(readConfirmByte == 'y' || readConfirmByte == 'n')) {
          if (Serial.available() > 0) {
            readConfirmByte = Serial.read();    // Read and process an incoming byte.
          }
          delay(60);
        }
        if (readConfirmByte != 'y') {
          Serial.println(F("+ Cancelled."));
          break;
        }
        Serial.println(F("+ Confirmed."));
        //
        host_set_status_led_HLDA();
        if (readProgramFileIntoMemory(theFilename)) {
          ledFlashSuccess();
          controlResetLogic();
          fpAddressToggleWord = 0;                // Reset all toggles to off.
          playerPlaySoundWait(READ_FILE);
        }
        printFrontPanel();
        host_clr_status_led_HLDA();
        break;
      }
    case 'M':
      {
        Serial.println(F("+ M, Write program Memory into a file."));
        String senseSwitchValue = getSenseSwitchValue();
        theFilename = senseSwitchValue + ".bin";
        if (theFilename == "11111111.bin") {
          Serial.println(F("- Warning, disabled, write to filename: 11111111.bin."));
          ledFlashError();
          return;
        }
        Serial.print(F("++ Write filename: "));
        Serial.println(theFilename);
        Serial.println(F("++ Confirm, y/n: "));
        readConfirmByte = 's';
        while (!(readConfirmByte == 'y' || readConfirmByte == 'n')) {
          if (Serial.available() > 0) {
            readConfirmByte = Serial.read();    // Read and process an incoming byte.
          }
          delay(60);
        }
        if (readConfirmByte != 'y') {
          Serial.println(F("+ Cancelled."));
          break;
        }
        Serial.println(F("+ Confirmed."));
        //
        host_set_status_led_HLDA();
        Serial.print(F("+ Write memory to filename: "));
        Serial.println(theFilename);
        // -------------------------------------------------------
        writeProgramMemoryToFile(theFilename);
        printFrontPanel();
        break;
      }
    // ----------------------------------------------------------------------
    case 'h':
      Serial.print(F("+ h, Print help information."));
      Serial.println();
      Serial.println();
      Serial.println(F("----------------------------------------------------"));
      Serial.println(F("+++ SD Card Controls"));
      Serial.println(F("-------------"));
      Serial.println(F("+ m, Read         Read an SD card file into program memory."));
      Serial.println(F("+ M, Write        Write program memory to an SD card file."));
      Serial.println(F("+ n, Directory    Directory file listing of the SD card."));
      Serial.println(F("------------------"));
      Serial.println(F("+ Ctrl+L          Clear screen."));
      Serial.println(F("+ X, Exit player  Return to program WAIT mode."));
      // Serial.println(F("------------------"));
      // Serial.println(F("+ i, Information  Program variables and hardward values."));
      Serial.println(F("----------------------------------------------------"));
      break;
    // ----------------------------------------------------------------------
    case 'i':
      Serial.println(F("+ Information"));
      break;
    case 12:
      // Ctrl+L, clear screen.
      Serial.print(F("\033[H\033[2J"));           // Cursor home and clear the screen.
      break;
    case 'X':
      Serial.println(F("+ Power or Key TV/VCR"));
      programState = PROGRAM_WAIT;
      break;
    // -----------------------------------
    default:
      // Serial.print(F("+ Result value: "));
      // Serial.print(resultsValue);
      // Serial.print(F(", HEX: "));
      // Serial.println(resultsValue, HEX);
      printPrompt = false;
      break;
      // ----------------------------------------------------------------------
  } // end switch
  if (printPrompt && (programState == SDCARD_RUN)) {
    Serial.print(thePrompt);
  }
}

// -----------------------------------------------------------------------------
// -----------------------------------------------------------------------------
// SD Card Control Loop.

void sdCardRun() {
  Serial.println(F("+ sdCardRun();"));
  Serial.println();
  Serial.print(thePrompt);
  while (programState == SDCARD_RUN) {
    // Process serial input key presses from a keyboard.
    if (Serial.available() > 0) {
      int readByte = Serial.read();    // Read and process an incoming byte.
      sdCardSwitch(readByte);
    }
    delay(60);  // Delay before getting the next key press, in case press and hold too long.
  }
}

// -----------------------------------------------------------------------------
