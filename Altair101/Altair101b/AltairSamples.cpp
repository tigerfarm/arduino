// -----------------------------------------------------------------------------
/*
  Load Altair 101a Sample programs into processor memory.

  Programs are loading from a PROGMEM array.
    static const byte PROGMEM pong[] = { ... }
*/
// -----------------------------------------------------------------------------
#include "cpuIntel8080.h"

int cnt;

// -----------------------------------------------------------------------------
// -----------------------------------------------------------------------------
// Load sample programs.

// -----------------------------------------------------------------------------
// -----------------------------------------------------------------------------
//  From prog_games.cpp, program hex bytes:

/*
    Need to update the speed.
*/
// PROGMEM Reference: https://forum.arduino.cc/?topic=723495#msg4868404
static const byte PROGMEM KillTheBitOriginal[] = {
  // const byte programBytes[] = {
  // Kill the Bit program.
  0x21, 0x00, 0x00, 0x16, 0x80, 0x01, 0x00, 0x08, 0x1A, 0x1A, 0x1A, 0x1A, 0x09, 0xD2, 0x08, 0x00,
  0xDB, 0x04, 0xAA, 0x0F, 0x57, 0xC3, 0x08, 0x00
};
/*
 * Original, with the speed value 0x0E:
  0x21, 0x00, 0x00, 0x16, 0x80, 0x01, 0x0E, 0x00, 0x1A, 0x1A, 0x1A, 0x1A, 0x09, 0xD2, 0x08, 0x00,
  0xDB, 0xFF, 0xAA, 0x0F, 0x57, 0xC3, 0x08, 0x00

++ Address:16-bit bytes       databyte :hex:oct > description
++       0:00000000 00000000: 00100001 : 21:041 > opcode: lxi h,0
++       1:00000000 00000001: 00000000 : 00:000 > lb: 0
++       2:00000000 00000010: 00000000 : 00:000 > hb: 0
++       3:00000000 00000011: 00010110 : 16:026 > opcode: mvi d,080h
++       4:00000000 00000100: 10000000 : 80:200 > immediate:  080h : 128
++       5:00000000 00000101: 00000001 : 01:001 > opcode: lxi b,800h
++       6:00000000 00000110: 00000000 : 00:000 > lb: 0                   + 0x0E : Original speed of the bit was different.
++       7:00000000 00000111: 00001000 : 08:010 > hb: 8                   + 0x08 : This matches my hardware and emulator software.
++       8:00000000 00001000: 00011010 : 1A:032 > opcode: ldax d
++       9:00000000 00001001: 00011010 : 1A:032 > opcode: ldax d
++      10:00000000 00001010: 00011010 : 1A:032 > opcode: ldax d
++      11:00000000 00001011: 00011010 : 1A:032 > opcode: ldax d
++      12:00000000 00001100: 00001001 : 09:011 > opcode: dad b
++      13:00000000 00001101: 11010010 : D2:322 > opcode: jnc Begin
++      14:00000000 00001110: 00001000 : 08:010 > lb: 8
++      15:00000000 00001111: 00000000 : 00:000 > hb: 0
++      16:00000000 00010000: 11011011 : DB:333 > opcode: in 004h         + Note, the sense switch input comes before the bit moves.
++      17:00000000 00010001: 00000100 : 04:004 > immediate:  004h : 4    + I changed from FFh to 04h to reduce the blinking panel lights.
++      18:00000000 00010010: 10101010 : AA:252 > opcode: xra d
++      19:00000000 00010011: 00001111 : 0F:017 > opcode: rrc
++      20:00000000 00010100: 01010111 : 57:127 > opcode: mov d,a
++      21:00000000 00010101: 11000011 : C3:303 > opcode: jmp Begin
++      22:00000000 00010110: 00001000 : 08:010 > lb: 8
++      23:00000000 00010111: 00000000 : 00:000 > hb: 0
+ End of list.
 */
void loadKillTheBitOriginal() {
  int theSize = sizeof(KillTheBitOriginal);
  int theLineCounter = 1;
  Serial.println(F("+ Octal listing,"));
  for (int i = 0; i < theSize; i++ ) {
    byte theValue = pgm_read_byte(&KillTheBitOriginal[i]);
    MWRITE(i, theValue);
    Serial.print(F(" 0x"));
    printOctal(theValue);
    if (theLineCounter > 16) {
      Serial.println();
      theLineCounter = 0;
    }
    theLineCounter++;
  }
}

// -----------------------------------------------------------------------------------------------------------
static const byte PROGMEM virtualKtb[] = {
  22,  128,   26,   26,   26,   26,   26,   26,   26,   26,   26,   26,   26,   26,  219,    4,
  170,   15,   87,  195,    2,    0
};

void loadVirtualKtb() {
  int theSize = sizeof(virtualKtb);
  int theLineCounter = 1;
  Serial.println(F("+ Octal listing,"));
  for (int i = 0; i < theSize; i++ ) {
    byte theValue = pgm_read_byte(&virtualKtb[i]);
    MWRITE(i, theValue);
    Serial.print(F(" 0x"));
    printOctal(theValue);
    if (theLineCounter > 16) {
      Serial.println();
      theLineCounter = 0;
    }
    theLineCounter++;
  }
}

// -----------------------------------------------------------------------------------------------------------
static const byte PROGMEM basic4k[] = {
  243,  195,   33,   13,  144,    4,  249,    7,  126,  227,  190,   35,  227,  194,  208,    1,
  35,  126,  254,   58,  208,  195,   94,    4,  245,   58,   39,    0,  195,  110,    3,    0,
  124,  146,  192,  125,  147,  201,    1,    0,   58,  114,    1,  183,  194,  218,    9,  201,
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  77,   69,   77,   79,   82,   89,   32,   83,   73,   90,  197,    0,    0
};

void loadBasic4k() {
  int theSize = sizeof(basic4k);
  int theLineCounter = 1;
  for (int i = 0; i < theSize; i++ ) {
    byte theValue = pgm_read_byte(&basic4k[i]);
    MWRITE(i, theValue);
    Serial.print(F("."));
    if (theLineCounter > 64) {
      Serial.println();
      theLineCounter = 0;
    }
    theLineCounter++;
  }
  Serial.println();
  Serial.print(F("+ Number of bytes loaded  = "));
  Serial.println(theSize);
}

// -----------------------------------------------------------------------------------------------------------
static const byte PROGMEM starWarsAttack[] = {
  2,    0,    2,  255,    2,  254,    1,  254,    0,  254,  255,  254,  254,  254,  254,  255,
  254,    0,  254,    1,  254,    2,  255,    2,    0,    2,    1,    2,    2,    2,    2,    1,
  0,    0,    0,    0,    0,    0,    0,    0,    0,    0,    0,    0,    0,    0,    0,    0,
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  0,   19,   21,    0,    0,    4,    6,    2,    3,   21,    0,    0,   21,    0,   39,    0
};

void loadStarWarsAttack() {
  int theSize = sizeof(starWarsAttack);
  int theLineCounter = 1;
  for (int i = 0; i < theSize; i++ ) {
    byte theValue = pgm_read_byte(&starWarsAttack[i]);
    MWRITE(i, theValue);
    Serial.print(F("."));
    if (theLineCounter > 64) {
      Serial.println();
      theLineCounter = 0;
    }
    theLineCounter++;
  }
  Serial.println();
  Serial.print(F("+ Number of bytes loaded  = "));
  Serial.println(theSize);
}

// -----------------------------------------------------------------------------------------------------------
// Program to try. I have not run it.

static const byte PROGMEM starWarsAttackMega[] = {
  2,    0,    2,  255,    2,  254,    1,  254,    0,  254,  255,  254,  254,  254,  254,  255,
  254,    0,  254,    1,  254,    2,  255,    2,    0,    2,    1,    2,    2,    2,    2,    1,
  255,  255,  255,  255,  255,  255,  255,  255,    0,    0,    0,    0,  255,  255,  255,  255,
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  0,    0,    0,    9,    5
};

void loadStarWarsAttackMega() {
  int theSize = sizeof(starWarsAttackMega);
  int theLineCounter = 1;
  for (int i = 0; i < theSize; i++ ) {
    byte theValue = pgm_read_byte(&starWarsAttackMega[i]);
    MWRITE(i, theValue);
    Serial.print(F("."));
    if (theLineCounter > 64) {
      Serial.println();
      theLineCounter = 0;
    }
    theLineCounter++;
  }
  Serial.println();
  Serial.print(F("+ Number of bytes loaded  = "));
  Serial.println(theSize);
}

// -----------------------------------------------------------------------------------------------------------
// Original Galaxy 80 program.

static const byte PROGMEM galaxy80[] = {
     2,    0,    2,  255,    2,  254,    1,  254,    0,  254,  255,  254,  254,  254,  254,  255, 
 254,    0,  254,    1,  254,    2,  255,    2,    0,    2,    1,    2,    2,    2,    2,    1, 
   0,    0,    0,    0,    0,    0,    0,    0,    0,    0,    0,    0,    0,    0,    0,    0, 
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  15,  219,   17,  230,  127,  195,  216,   15,   79,  121,  211,   17,  201,  205,  189,   15, 
 201
};

void loadGalaxy80() {
  int theSize = sizeof(galaxy80);
  int theLineCounter = 1;
  for (int i = 0; i < theSize; i++ ) {
    byte theValue = pgm_read_byte(&galaxy80[i]);
    MWRITE(i, theValue);
    Serial.print(F("."));
    if (theLineCounter > 64) {
      Serial.println();
      theLineCounter = 0;
    }
    theLineCounter++;
  }
  Serial.println();
  Serial.print(F("+ Number of bytes loaded  = "));
  Serial.println(theSize);
}

// -----------------------------------------------------------------------------------------------------------
// Program to try. I have not run it.

static const byte PROGMEM pong[] = {
  0001, 0016, 0000, 0061, 0175, 0000, 0041, 0000, 0000, 0042, 0200, 0000, 0021, 0000, 0200, 0303,
  0036, 0000, 0041, 0000, 0000, 0032, 0032, 0032, 0032, 0011, 0322, 0025, 0000, 0311, 0315, 0022,
  0000, 0333, 0377, 0346, 0001, 0312, 0055, 0000, 0172, 0263, 0346, 0037, 0137, 0172, 0346, 0001,
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  0200, 0000, 0064, 0036, 0000, 0172, 0007, 0127, 0303, 0113, 0000
};

// -----------------------------------------------------------------------------
// An old loading method.
void loadMviRegisters() {
  cnt = 0;
  MWRITE( cnt++, B00111110 & 0xff);  // ++ opcode:mvi:00111110:a:1
  Serial.print(F(". "));
  MWRITE( cnt++, B00000001 & 0xff);  // ++ immediate:1:1
  Serial.print(F(". "));
  MWRITE( cnt++, B00000110 & 0xff);  // ++ opcode:mvi:00000110:b:2
  Serial.print(F(". "));
  MWRITE( cnt++, B00000010 & 0xff);  // ++ immediate:2:2
  Serial.print(F(". "));
  MWRITE( cnt++, B00001110 & 0xff);  // ++ opcode:mvi:00001110:c:3
  Serial.print(F(". "));
  MWRITE( cnt++, B00000011 & 0xff);  // ++ immediate:3:3
  Serial.print(F(". "));
  MWRITE( cnt++, B00010110 & 0xff);  // ++ opcode:mvi:00010110:d:4
  Serial.print(F(". "));
  MWRITE( cnt++, B00000100 & 0xff);  // ++ immediate:4:4
  Serial.print(F(". "));
  MWRITE( cnt++, B00011110 & 0xff);  // ++ opcode:mvi:00011110:e:5
  Serial.print(F(". "));
  MWRITE( cnt++, B00000101 & 0xff);  // ++ immediate:5:5
  Serial.print(F(". "));
  MWRITE( cnt++, B00100110 & 0xff);  // ++ opcode:mvi:00100110:h:6
  Serial.print(F(". "));
  MWRITE( cnt++, B00000110 & 0xff);  // ++ immediate:6:6
  Serial.print(F(". "));
  MWRITE( cnt++, B00101110 & 0xff);  // ++ opcode:mvi:00101110:l:7
  Serial.print(F(". "));
  MWRITE( cnt++, B00000111 & 0xff);  // ++ immediate:7:7
  Serial.print(F(". "));
  MWRITE( cnt++, B01110110 & 0xff);  // ++ opcode:hlt:01110110
  Serial.print(F(". "));
  MWRITE( cnt++, B11000011 & 0xff);  // ++ opcode:jmp:11000011:Start
  Serial.print(F(". "));
  MWRITE( cnt++, B00000000 & 0xff);  // ++ lb:Start:0
  Serial.print(F(". "));
  MWRITE( cnt++, B00000000 & 0xff);  // ++ hb:0
  Serial.print(F(". "));
}

// -----------------------------------------------------------------------------------------------------------
// -----------------------------------------------------------------------------------------------------------
// Processor WAIT mode: Load sample programs.

void loadProgramList() {
  Serial.println(F("----------------------------------------"));
  Serial.println(F("+ Sample programs to load and run:"));
  Serial.println(F("----------"));
  Serial.println(F("++ r, Test the setting of registers."));
  Serial.println(F("++ b, MITS Altair Basic 4K."));
  //
#if defined(__SAM3X8E__)
  Serial.println(F("++ g, Due version of Star Wars Attack game which is a variation of the Star Trek game."));
#endif
  // -------------------
#ifndef Altair101b
  // Run on Altair101a, Mega and Due.
  Serial.println(F("++ G, Mega version of Star Wars Attack game which runs on a Mega. "));
#else
#if defined(__SAM3X8E__)
  // Since it's Altair101b, this only works with Due.
  Serial.println(F("++ G, Mega version of Star Wars Attack game which runs on a Mega. "));
#endif
#endif
  Serial.println(F("++ f, Original Galaxy 80 game which I changed for my Star Wars Attack game."));
  // -------------------
  //
  Serial.println(F("----------"));
  Serial.println(F("++ k, Virtual front panel version of Kill the Bit."));
  Serial.println(F("++ K, Load the original version of virtual Kill the Bit."));
  Serial.println(F("----------"));
  Serial.println(F("++ x, Exit: don't load a program."));
}

void loadProgram() {
#ifdef LOG_MESSAGES
  Serial.println(F("+ loadProgram()"));
#endif
  if (loadProgramName != "") {
    Serial.print(F("+ Program previously loaded: "));
    Serial.println(loadProgramName);
  }
  programState = PROGRAM_LOAD;
  loadProgramList();
  while (programState == PROGRAM_LOAD) {
    if (Serial.available() > 0) {
      readByte = Serial.read();    // Read and process an incoming byte.
      if (VIRTUAL_FRONT_PANEL) {
        Serial.print(F("\033[9;1H"));  // Move cursor to below the prompt: line 9, column 1.
        Serial.print(F("\033[J"));     // From cursor down, clear the screen.
      }
      switch (readByte) {
        case 'r':
          loadProgramName = "Set the registers";
          Serial.println(F("+ A program that uses MVI to set the registers:"));
          Serial.println(F("  A, B, C, D, E, H, and L; with values from 1 to 7."));
          programState = PROGRAM_WAIT;
          if (VIRTUAL_FRONT_PANEL) {
            Serial.print(F("\033[J"));     // From cursor down, clear the screen, .
          }
          loadMviRegisters();
          Serial.println();
          Serial.println(F("+ Program loaded and ready to run."));
          Serial.println(F("  Use option 'i' to list the register values before and after running this program."));
          break;
        case 'b':
          loadProgramName = "MITS Altair 4K Basic";
          Serial.println(F("+ MITS Altair Basic 4K."));
          programState = PROGRAM_WAIT;
          if (VIRTUAL_FRONT_PANEL) {
            Serial.print(F("\033[J"));     // From cursor down, clear the screen, .
          }
          loadBasic4k();
          Serial.print(F("+ Program loaded and ready to run: "));
          Serial.println(loadProgramName);
          break;
#if defined(__SAM3X8E__)
        case 'g':
          loadProgramName = "Star Wars Attack game, Arduino Due version";
          Serial.println(F("+ Load Star Wars Attack, a variation of the Star Trek game."));
          programState = PROGRAM_WAIT;
          if (VIRTUAL_FRONT_PANEL) {
            Serial.print(F("\033[J"));     // From cursor down, clear the screen, .
          }
          loadStarWarsAttack();
          Serial.print(F("+ Program loaded and ready to run: "));
          Serial.println(loadProgramName);
          Serial.println(F("+ Start the program at address 1280."));
          Serial.println(F("  Toggle S8(key 8) and S10(key A) on and EXAMINE(key x) the byte at that address, 1280."));
          Serial.println(F("  Then run the program."));
          break;
#endif
          // -----------------------------------------------------------------------------------
#ifndef Altair101b
        // If Altair101b not defined, then is version: Altair101a. This game option works with both Mega and Due for Altair101a.
        case 'G':
          loadProgramName = "Star Wars Attack game, Arduino Mega version";
          Serial.println(F("+ Load Star Wars Attack, a variation of the Star Trek game for a Mega board."));
          programState = PROGRAM_WAIT;
          if (VIRTUAL_FRONT_PANEL) {
            Serial.print(F("\033[J"));     // From cursor down, clear the screen, .
          }
          loadStarWarsAttackMega();
          Serial.print(F("+ Program loaded and ready to run: "));
          Serial.println(loadProgramName);
          Serial.println(F("+ Start the program at address 1280."));
          Serial.println(F("  Toggle S8(key 8) and S10(key A) on and EXAMINE(key x) the byte at that address, 1280."));
          Serial.println(F("  Then run the program."));
          break;
          // -------------------------------------
#else
          // Since it's Altair101b, this only works with Due.
#if defined(__SAM3X8E__)
        case 'G':
          loadProgramName = "Star Wars Attack game, Arduino Mega version";
          Serial.println(F("+ Load Star Wars Attack, a variation of the Star Trek game for a Mega board."));
          programState = PROGRAM_WAIT;
          if (VIRTUAL_FRONT_PANEL) {
            Serial.print(F("\033[J"));     // From cursor down, clear the screen, .
          }
          loadStarWarsAttackMega();
          Serial.print(F("+ Program loaded and ready to run: "));
          Serial.println(loadProgramName);
          Serial.println(F("+ Start the program at address 1280."));
          Serial.println(F("  Toggle S8(key 8) and S10(key A) on and EXAMINE(key x) the byte at that address, 1280."));
          Serial.println(F("  Then run the program."));
          break;
          // -------------------------------------
#endif
#endif
        // -------------------------------------
        case 'f':
          loadProgramName = "Original Galaxy 80 game";
          Serial.println(F("+ Load original Galaxy 80 game, a variation of the Star Trek game."));
          programState = PROGRAM_WAIT;
          if (VIRTUAL_FRONT_PANEL) {
            Serial.print(F("\033[J"));     // From cursor down, clear the screen, .
          }
          loadGalaxy80();
          Serial.print(F("+ Program loaded and ready to run: "));
          Serial.println(loadProgramName);
          Serial.println(F("+ Start the program at address ?."));
          Serial.println(F("  Toggle S0(key 0), S1, S5, S7, S8 and S11(key b) on."));
          Serial.println(F("  Switch EXAMINE(key x) the byte at that address, 2467."));
          Serial.println(F("  Then run the program."));
          break;
        // -----------------------------------------------------------------------------------
        //
        case 'k':
          loadProgramName = "Virtual version of Kill the Bit";
          Serial.println(F("+ A version of Kill the Bit for the virtual front panel."));
          programState = PROGRAM_WAIT;
          if (VIRTUAL_FRONT_PANEL) {
            Serial.print(F("\033[J"));     // From cursor down, clear the screen, .
          }
          loadVirtualKtb();
          Serial.println();
          Serial.println(F("+ Program loaded and ready to run."));
          break;
        case 'K':
          loadProgramName = "Original version of Kill the Bit";
          Serial.println(F("+ The original version of Kill the Bit."));
          programState = PROGRAM_WAIT;
          if (VIRTUAL_FRONT_PANEL) {
            Serial.print(F("\033[J"));     // From cursor down, clear the screen, .
          }
          loadKillTheBitOriginal();
          Serial.println();
          Serial.println(F("+ Program loaded and ready to run."));
          Serial.println(F("+ The speed parameter will need to be adjusted to run on the virtual front panel."));
          break;
        // -------------------------------------
        case 'x':
          Serial.println(F("< x, Exit load program."));
          programState = PROGRAM_WAIT;
          if (VIRTUAL_FRONT_PANEL) {
            Serial.print(F("\033[J"));     // From cursor down, clear the screen, .
          }
          break;
        default:
          if (VIRTUAL_FRONT_PANEL) {
            Serial.print(F("\033[9;1H"));  // Move cursor to below the prompt: line 9, column 1.
            Serial.print(F("\033[J"));     // From cursor down, clear the screen, .
          }
          loadProgramList();
          Serial.print(F("?- "));
      }
    }
  }
  if (readByte != 'x') {
    // Do EXAMINE 0 after the load;
    regPC = 0;
    setAddressData(regPC, MREAD(regPC));
    if (VIRTUAL_FRONT_PANEL) {
      printVirtualFrontPanel();
    }
  }
}

// -----------------------------------------------------------------------------
// eof
