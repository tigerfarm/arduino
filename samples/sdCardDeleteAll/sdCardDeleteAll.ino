// -----------------------------------------------------------------------------
/*
  Delete all files and directories from a Micro SD Card Module.

  +++ Needs work, not complete

  Connections,
      Mega Nano - SPI module pins
  Pin 53   10   - CS   : chip/slave select (SS pin). Can be any master(Nano) digital pin to enable/disable this device on the SPI bus.
  Pin 52   13   - SCK  : serial clock, SPI: accepts clock pulses which synchronize data transmission generated by Arduino.
  Pin 51   11   - MOSI : master out slave in, SPI: input to the Micro SD Card Module.
  Pin 50   12   - MISO : master in slave Out, SPI: output from the Micro SD Card Module.
  Pin 5V+  5V+  - VCC  : can use 3.3V or 5V
  Pin GND  GND  - GND  : ground
  Notes,
  + This program was tested successfully with a Mega and a Nano.
  + Pins are declared in the SPI library for SCK, MOSI, and MISO.

  Reference documentation,
    https://www.arduino.cc/en/reference/SD
  Get SD card information,
    https://www.arduino.cc/en/Tutorial/CardInfo
  List files,
    https://www.arduino.cc/en/Tutorial/listfiles
  SPI reference:
    https://www.arduino.cc/en/Reference/SPI

*/
// -----------------------------------------------------------------------------
// Used with the SD Card module.
// I have SD library by Arduiono, SparkFun version 1.2.3.

#include <SPI.h>
#include <SD.h>

String theFilename = "f1.txt";  // Files are created using uppercase: F1.TXT.

// Set to match your SD module to the Arduino pin.
// The CS pin is the only one that is not really fixed as any of the Arduino digital pin.
const int csPin = 10;  // SD Card module is connected to Nano pin 10.
// const int csPin = 53;  // SD Card module is connected to Mega pin 53.
// Notes,
// + The default is the hardware SS line (pin 10 or 53) of the SPI bus.
// + The SS pin is connected to the chip select pin (CS) of the SD card adapter.
// + If using a pin other than the default, add: pinMode(csPin, OUTPUT);

File myFile;
File root;

// -----------------------------------------------------------------------------
// -----------------------------------------------------------------------------

// Handle the case if the card is not inserted.
// Once inserted, the module will be re-initialized, and program continues.
boolean sdcardInitiated = false;
void initSdcard() {
  if (SD.begin(csPin)) {
    Serial.println(F("+ SD card initialized."));
    sdcardInitiated = true;
    return;
  }
  sdcardInitiated = false;
  Serial.println(F("- Error initializing SD card."));
  Serial.println(F("-- Check that SD card is inserted"));
  Serial.println(F("-- Check that SD card adapter is wired properly."));
  //
  // Retry until the card is ready for use.
  // For example,
  //  + Eject the card, you will get the above error messages.
  //  + Insert the card, and the initialization succeeds and the program continues.
  int counter = 0;
  while (!SD.begin(csPin)) {
    Serial.print(".");
    if (counter == 30) {
      Serial.println("");
      counter = 0;
    }
    delay(500);
  }
  Serial.println(F("+ SD card initialized."));
}

// -----------------------------------------------------------------------------
// Delete the file and confirm it was deleted.

void deleteFileAndConfirm() {
  Serial.print(F("+ Delete the file: "));
  Serial.println(theFilename);
  SD.remove(theFilename);
  //
  Serial.println(F("+ Confirm file was deleted."));
  if (SD.exists(theFilename)) {
    Serial.print(F("++ File exists, it was not deleted: "));
  } else {
    Serial.print(F("++ File was deleted: "));
  }
  Serial.println(theFilename);
}

// -----------------------------------------------------------------------------
void printSpacing(String theString) {
  for (int i = theString.length(); i < 14; i++) {
    Serial.print(" ");
  }
}

int numTabs;
void listDirectories(File dir, int numTabs) {
  // Use recursion to list all files and directories.
  String tabString = "   ";
  File entry =  dir.openNextFile();
  while (entry) {
    for (int i = 0; i < numTabs; i++) {
      Serial.print(tabString);
    }
    Serial.print(entry.name());
    if (entry.isDirectory()) {
      // Directory
      Serial.println("/");
      listDirectories(entry, numTabs + 1);
    } else {
      // File
      printSpacing(entry.name());
      Serial.print(entry.size(), DEC);
      Serial.print(" ");
      Serial.println(dir.name());
      char fullName[50] = dir.name() + "/" + entry.name()
      SD.remove(fullName);
    }
    entry.close();
    entry =  dir.openNextFile();
  }
}

void listDirectory(File dir) {
  // List files for a single directory.
  String tabString = "   ";
  File entry = dir.openNextFile();
  while (entry) {
    if (entry.isDirectory()) {
      Serial.print(F("++ Directory: "));
      Serial.print(entry.name());
    } else {
      Serial.print(F("++ File:      "));
      Serial.print(entry.name());
      printSpacing(entry.name());
      Serial.print(entry.size(), DEC);
    }
    Serial.println("");
    entry.close();
    entry =  dir.openNextFile();
  }
}

// -----------------------------------------------------------------------------
void setup() {
  Serial.begin(115200);
  // Give the serial connection time to start before the first print.
  delay(1000);
  Serial.println(""); // Newline after garbage characters.
  Serial.println(F("+++ Setup."));

  initSdcard();

  // -----------------------------------------------------------------------------
  // Test directory functions.

  Serial.println("");
  Serial.println(F("---------------------------------------------"));
  Serial.println(F("+ Delete SD card files,"));
  root = SD.open("/");
  listDirectories(root, 0);
  Serial.println(F("+ End listing."));
  Serial.println("");

  Serial.println(F("---------------------------------------------"));
  Serial.println(F("+ List SD card root directory,"));
  root.rewindDirectory();
  listDirectory(root);
  Serial.println(F("+ End listing."));

  // SD.rmdir(aDirName);

  Serial.println(F("+++ Go to loop."));
}

// -----------------------------------------------------------------------------
// Device Loop
void loop() {
  Serial.println(F("+ Loop."));
  delay(3000);
}
// -----------------------------------------------------------------------------
